## config/boards/shields/clover/Kconfig.defconfig
```kconfig
if SHIELD_CLOVER_LEFT

config ZMK_KEYBOARD_NAME
    default "clover"

config ZMK_SPLIT_ROLE_CENTRAL
    default y

endif

if SHIELD_CLOVER_LEFT || SHIELD_CLOVER_RIGHT

config ZMK_SPLIT
    default y

endif
```

## config/boards/shields/clover/Kconfig.shield
```kconfig
config SHIELD_CLOVER_LEFT
    def_bool $(shields_list_contains,clover_left)

config SHIELD_CLOVER_RIGHT
    def_bool $(shields_list_contains,clover_right)
```
